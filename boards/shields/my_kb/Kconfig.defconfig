## boards/shields/my_kb/Kconfig.defconfig
```kconfig
if SHIELD_MY_KB_LEFT


    # 左側をセントラル（親機）に設定
    config ZMK_SPLIT_ROLE_CENTRAL
        default n
endif

if SHIELD_MY_KB_RIGHT
    # 右側はペリフェラル（子機）なので、セントラルを n にする
    config ZMK_SPLIT_ROLE_CENTRAL
        default y
    config ZMK_KEYBOARD_NAME

        default "SPLIT KEY"
endif

if SHIELD_MY_KB_LEFT || SHIELD_MY_KB_RIGHT
    config ZMK_SPLIT
        default y
endif
```

## boards/shields/my_kb/Kconfig.shield
```kconfig
config SHIELD_MY_KB_LEFT
    def_bool $(shields_list_contains,my_kb_left)

config SHIELD_MY_KB_RIGHT
    def_bool $(shields_list_contains,my_kb_right)
```
