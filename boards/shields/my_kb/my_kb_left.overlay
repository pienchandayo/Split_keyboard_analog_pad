#include "my_kb.dtsi"

/ {
    chosen {
        zmk,kscan = &kscan0;
    };

    kscan0: kscan {
        compatible = "zmk,kscan-gpio-matrix";
        diode-direction = "col2row";

        col-gpios
            = <&gpio0 24 GPIO_ACTIVE_HIGH> // COL0
            , <&gpio0 11 GPIO_ACTIVE_HIGH> // COL2
            , <&gpio1  0 GPIO_ACTIVE_HIGH> // COL1
            , <&gpio1  4 GPIO_ACTIVE_HIGH> // COL3
            , <&gpio1  6 GPIO_ACTIVE_HIGH> // COL4
            , <&gpio0 10 GPIO_ACTIVE_HIGH> // COL5
            , <&gpio0  9 GPIO_ACTIVE_HIGH> // COL6
            ;

        row-gpios
            = <&gpio0  6 (GPIO_ACTIVE_HIGH | GPIO_PULL_DOWN)> // ROW0
            , <&gpio0  8 (GPIO_ACTIVE_HIGH | GPIO_PULL_DOWN)> // ROW1
            , <&gpio0 17 (GPIO_ACTIVE_HIGH | GPIO_PULL_DOWN)> // ROW2
            , <&gpio0 20 (GPIO_ACTIVE_HIGH | GPIO_PULL_DOWN)> // ROW3
            , <&gpio0 22 (GPIO_ACTIVE_HIGH | GPIO_PULL_DOWN)> // ROW4
            ;
    };
};

&default_transform { // Offset of 3 because the left side has 3 columns
        col-offset = <7>;
    };